## Tuần 6/blink_app/Config.in
```kconfig
config BR2_PACKAGE_BLINK_APP
	bool "blink_app"
	help
      		Blink LED application.
```

## Tuần 6/gpio_driver/Config.in
```kconfig
config BR2_PACKAGE_GPIO_DRIVER
	bool "gpio_driver"
	depends on BR2_LINUX_KERNEL
	help
      		Custom GPIO 60 Driver for BeagleBone Black.
```
